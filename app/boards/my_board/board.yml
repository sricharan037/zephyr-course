## app/boards/my_board/board.yml
```yaml
board:
  name: my_board
  full_name: MY BOARD
  vendor: espressif
  socs:
  - name: esp32
```

## app/boards/our_board/board.yml
```yaml
board:
  name: our_board
  full_name: OUR BOARD
  vendor: espressif
  socs:
  - name: esp32
```

## app/drivers/my_driver_module/drivers/sensor/led_sensor/Kconfig
```kconfig
config LED_SENSOR
    bool "LED Mock Sensor Driver"
    default y
    depends on DT_HAS_MY_LED_SENSOR_ENABLED
    select SENSOR
    select GPIO
    help
      Enable driver for the LED-based mock sensor.
```

## app/drivers/my_driver_module/dts/bindings/sensor/my,led-sensor.yaml
```yaml
description: LED Mock Sensor Driver Binding
compatible: "my,led-sensor"

include: [sensor-device.yaml, base.yaml]

properties:
  led-gpios:
    type: phandle-array
    required: true
    description: GPIO connected to the LED.
```
